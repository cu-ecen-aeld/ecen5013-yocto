## meta-ecen5013/conf/layer.conf
```bitbake
# We have a conf and classes directory, add to BBPATH
BBPATH .= ":${LAYERDIR}"

# We have recipes-* directories, add to BBFILES
BBFILES += "${LAYERDIR}/recipes-*/*/*.bb \
            ${LAYERDIR}/recipes-*/*/*.bbappend"

BBFILE_COLLECTIONS += "meta-ecen5013"
BBFILE_PATTERN_meta-ecen5013 = "^${LAYERDIR}/"
BBFILE_PRIORITY_meta-ecen5013 = "6"

LAYERDEPENDS_meta-ecen5013 = "core"
LAYERSERIES_COMPAT_meta-ecen5013 = "kirkstone"
```
